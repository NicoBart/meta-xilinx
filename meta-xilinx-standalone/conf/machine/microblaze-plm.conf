## meta-xilinx-standalone/conf/machine/microblaze-plm.conf
```bitbake
DEFAULTTUNE ?= "microblaze"

require conf/machine/include/soc-versal.inc

# Match embeddedsw plm setting of:
# -mlittle-endian -mxl-barrel-shift -mxl-pattern-compare -mno-xl-soft-div -mcpu=v10.0 -mno-xl-soft-mul -mxl-multiply-high
AVAILTUNES += "microblaze"
TUNE_FEATURES_tune-microblaze = "microblaze v10.0 barrel-shift pattern-compare multiply-high divide-hard"
PACKAGE_EXTRA_ARCHS_tune-microblaze = "${TUNE_PKGARCH}"

LINKER_HASH_STYLE_microblaze = ""
```

## meta-xilinx-standalone/conf/machine/microblaze-psm.conf
```bitbake
DEFAULTTUNE ?= "microblaze"

require conf/machine/include/soc-versal.inc

# -mcpu=v -mlittle-endian -mxl-barrel-shift -mxl-pattern-compare
AVAILTUNES += "microblaze"
TUNE_FEATURES_tune-microblaze = "microblaze v11.0 barrel-shift pattern-compare"
PACKAGE_EXTRA_ARCHS_tune-microblaze = "${TUNE_PKGARCH}"

LINKER_HASH_STYLE_microblaze = ""
```
